## conf/layer.conf
```bitbake
# We have a conf and classes directory, add to BBPATH
BBPATH .= ":${LAYERDIR}"

# We have recipes-* directories, add to BBFILES
BBFILES += "${LAYERDIR}/recipes-*/*/*.bb \
	${LAYERDIR}/recipes-*/*/*.bbappend"

BBFILE_COLLECTIONS += "monark"
BBFILE_PATTERN_monark = "^${LAYERDIR}/"
BBFILE_PRIORITY_monark = "11"

LAYERSERIES_COMPAT_monark = "kirkstone"
```
